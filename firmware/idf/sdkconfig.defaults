## firmware/idf/sdkconfig.defaults
```kconfig
CONFIG_IDF_TARGET="esp32s3"
CONFIG_AUTOSTART_ARDUINO=y
CONFIG_ARDUINO_VARIANT="XIAO_ESP32S3"
CONFIG_ARDUINO_LOOP_STACK_SIZE=16384
CONFIG_FREERTOS_HZ=1000
CONFIG_PM_ENABLE=y
CONFIG_FREERTOS_USE_TICKLESS_IDLE=y
CONFIG_ESPTOOLPY_FLASHSIZE_8MB=y
CONFIG_PARTITION_TABLE_CUSTOM=y
CONFIG_PARTITION_TABLE_CUSTOM_FILENAME="partitions.csv"
CONFIG_LOG_DEFAULT_LEVEL_NONE=y
```
